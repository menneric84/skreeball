## boards/shields/rickball/Kconfig.defconfig
```kconfig
if SHIELD_rickball_RIGHT

config ZMK_KEYBOARD_NAME
    default "rickball"

config ZMK_SPLIT_ROLE_CENTRAL
    default y

endif # SHIELD_rickball_RIGHT

if SHIELD_rickball_LEFT || SHIELD_rickball_RIGHT

config ZMK_SPLIT
    default y

endif # SHIELD_rickball_LEFT || SHIELD_rickball_RIGHT
```

## boards/shields/rickball/Kconfig.shield
```kconfig
config SHIELD_rickball_LEFT
    def_bool $(shields_list_contains,rickball_left)

config SHIELD_rickball_RIGHT
    def_bool $(shields_list_contains,rickball_right)
```

## boards/shields/skree/Kconfig.defconfig
```kconfig
if SHIELD_skree_LEFT

config ZMK_KEYBOARD_NAME
    default "skree"

config ZMK_SPLIT_ROLE_CENTRAL
    default y

endif # SHIELD_skree_LEFT

if SHIELD_skree_LEFT || SHIELD_skree_RIGHT

config ZMK_SPLIT
    default y

endif # SHIELD_skree_LEFT || SHIELD_skree_RIGHT
```

## boards/shields/skree/Kconfig.shield
```kconfig
config SHIELD_skree_LEFT
    def_bool $(shields_list_contains,skree_left)

config SHIELD_skree_RIGHT
    def_bool $(shields_list_contains,skree_right)
```

## config/west.yml
```yaml
manifest:
  remotes:
    - name: zmkfirmware
      url-base: https://github.com/zmkfirmware
    - name: rianadon
      url-base: https://github.com/rianadon
    - name: sadekbaroudi
      url-base: https://github.com/sadekbaroudi
  projects:
    - name: zmk
      remote: rianadon
      revision: main
      import: app/west.yml
    - name: zmk-fingerpunch-vik
      remote: sadekbaroudi
      revision: main
      import: config/deps.yml
  self:
    path: config
    import: deps.yml
```
